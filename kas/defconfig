## kas/defconfig
```kconfig
# CONFIG_LOCALVERSION_AUTO is not set
CONFIG_SYSVIPC=y
# CONFIG_CROSS_MEMORY_ATTACH is not set
CONFIG_NO_HZ_FULL=y
CONFIG_HIGH_RES_TIMERS=y
CONFIG_PREEMPT_RT=y
CONFIG_CGROUPS=y
CONFIG_MEMCG=y
CONFIG_CGROUP_PIDS=y
CONFIG_CPUSETS=y
CONFIG_CGROUP_DEVICE=y
CONFIG_EXPERT=y
CONFIG_ARCH_ROCKCHIP=y
# CONFIG_AMPERE_ERRATUM_AC03_CPU_38 is not set
# CONFIG_AMPERE_ERRATUM_AC04_CPU_23 is not set
# CONFIG_ARM64_ERRATUM_826319 is not set
# CONFIG_ARM64_ERRATUM_827319 is not set
# CONFIG_ARM64_ERRATUM_824069 is not set
# CONFIG_ARM64_ERRATUM_819472 is not set
# CONFIG_ARM64_ERRATUM_832075 is not set
# CONFIG_ARM64_ERRATUM_843419 is not set
# CONFIG_ARM64_ERRATUM_1024718 is not set
# CONFIG_ARM64_ERRATUM_1165522 is not set
# CONFIG_ARM64_ERRATUM_1319367 is not set
# CONFIG_ARM64_ERRATUM_1530923 is not set
# CONFIG_ARM64_ERRATUM_1463225 is not set
# CONFIG_ARM64_ERRATUM_1508412 is not set
# CONFIG_ARM64_ERRATUM_2051678 is not set
# CONFIG_ARM64_ERRATUM_2077057 is not set
# CONFIG_ARM64_ERRATUM_2658417 is not set
# CONFIG_ARM64_ERRATUM_2054223 is not set
# CONFIG_ARM64_ERRATUM_2067961 is not set
# CONFIG_ARM64_ERRATUM_2645198 is not set
# CONFIG_ARM64_ERRATUM_2966298 is not set
# CONFIG_ARM64_ERRATUM_3117295 is not set
# CONFIG_ARM64_ERRATUM_3194386 is not set
# CONFIG_CAVIUM_ERRATUM_22375 is not set
# CONFIG_CAVIUM_ERRATUM_23154 is not set
# CONFIG_CAVIUM_ERRATUM_27456 is not set
# CONFIG_CAVIUM_ERRATUM_30115 is not set
# CONFIG_CAVIUM_TX2_ERRATUM_219 is not set
# CONFIG_FUJITSU_ERRATUM_010001 is not set
# CONFIG_HISILICON_ERRATUM_161600802 is not set
# CONFIG_HISILICON_ERRATUM_162100801 is not set
# CONFIG_QCOM_FALKOR_ERRATUM_1003 is not set
# CONFIG_QCOM_FALKOR_ERRATUM_1009 is not set
# CONFIG_QCOM_QDF2400_ERRATUM_0065 is not set
# CONFIG_QCOM_FALKOR_ERRATUM_E1041 is not set
# CONFIG_NVIDIA_CARMEL_CNP_ERRATUM is not set
# CONFIG_ROCKCHIP_ERRATUM_3568002 is not set
# CONFIG_ROCKCHIP_ERRATUM_3588001 is not set
# CONFIG_SOCIONEXT_SYNQUACER_PREITS is not set
CONFIG_NR_CPUS=4
CONFIG_HZ_1000=y
# CONFIG_ARM64_TAGGED_ADDR_ABI is not set
# CONFIG_ARM64_RAS_EXTN is not set
# CONFIG_ARM64_PTR_AUTH is not set
# CONFIG_ARM64_AMU_EXTN is not set
# CONFIG_ARM64_BTI is not set
# CONFIG_ARM64_E0PD is not set
# CONFIG_ARM64_POE is not set
# CONFIG_ARM64_GCS is not set
# CONFIG_ARM64_SVE is not set
CONFIG_RANDOMIZE_BASE=y
# CONFIG_EFI is not set
# CONFIG_SUSPEND is not set
CONFIG_WQ_POWER_EFFICIENT_DEFAULT=y
CONFIG_ENERGY_MODEL=y
CONFIG_CPU_FREQ=y
CONFIG_CPUFREQ_DT=y
# CONFIG_SCHED_SMT is not set
# CONFIG_SCHED_CLUSTER is not set
# CONFIG_STACKPROTECTOR is not set
# CONFIG_GCC_PLUGINS is not set
# CONFIG_BLOCK_LEGACY_AUTOLOAD is not set
# CONFIG_BLK_DEV_WRITE_MOUNTED is not set
# CONFIG_MQ_IOSCHED_KYBER is not set
# CONFIG_IOSCHED_BFQ is not set
# CONFIG_SWAP is not set
# CONFIG_SLAB_MERGE_DEFAULT is not set
# CONFIG_COMPAT_BRK is not set
CONFIG_CMA=y
CONFIG_NET=y
CONFIG_PACKET=y
CONFIG_UNIX=y
CONFIG_INET=y
CONFIG_DEVTMPFS=y
CONFIG_DEVTMPFS_MOUNT=y
# CONFIG_STANDALONE is not set
# CONFIG_PREVENT_FIRMWARE_BUILD is not set
CONFIG_FW_LOADER_USER_HELPER=y
# CONFIG_ARM_SMCCC_SOC_ID is not set
# CONFIG_BLK_DEV is not set
CONFIG_SRAM=y
CONFIG_NETDEVICES=y
# CONFIG_INPUT_KEYBOARD is not set
# CONFIG_INPUT_MOUSE is not set
# CONFIG_LEGACY_PTYS is not set
# CONFIG_LEGACY_TIOCSTI is not set
# CONFIG_LDISC_AUTOLOAD is not set
# CONFIG_HW_RANDOM_ARM_SMCCC_TRNG is not set
# CONFIG_DEVMEM is not set
# CONFIG_DEVPORT is not set
# CONFIG_PTP_1588_CLOCK is not set
CONFIG_POWER_RESET_SYSCON=y
CONFIG_POWER_RESET_SYSCON_POWEROFF=y
CONFIG_SYSCON_REBOOT_MODE=y
# CONFIG_HWMON is not set
CONFIG_THERMAL=y
CONFIG_THERMAL_DEFAULT_GOV_POWER_ALLOCATOR=y
CONFIG_THERMAL_GOV_POWER_ALLOCATOR=y
CONFIG_CPU_THERMAL=y
CONFIG_ROCKCHIP_THERMAL=y
CONFIG_REGULATOR=y
CONFIG_REGULATOR_FIXED_VOLTAGE=y
CONFIG_DRM=y
CONFIG_DRM_ROCKCHIP=y
CONFIG_ROCKCHIP_DW_HDMI=y
CONFIG_ROCKCHIP_INNO_HDMI=y
CONFIG_FB=y
CONFIG_LOGO=y
# CONFIG_HID_SUPPORT is not set
CONFIG_USB=y
CONFIG_USB_DWC3=y
CONFIG_USB_GADGET=y
CONFIG_USB_CONFIGFS=y
CONFIG_USB_CONFIGFS_ECM=y
CONFIG_USB_CONFIGFS_F_FS=y
CONFIG_MMC=y
CONFIG_MMC_DW=y
CONFIG_MMC_DW_ROCKCHIP=y
CONFIG_MMC_CQHCI=y
CONFIG_NEW_LEDS=y
CONFIG_LEDS_CLASS=y
CONFIG_LEDS_GPIO=y
CONFIG_DMADEVICES=y
# CONFIG_VIRTIO_MENU is not set
# CONFIG_VHOST_MENU is not set
# CONFIG_SURFACE_PLATFORMS is not set
# CONFIG_ARM64_PLATFORM_DEVICES is not set
# CONFIG_ARM_ARCH_TIMER_EVTSTREAM is not set
# CONFIG_FSL_ERRATUM_A008585 is not set
# CONFIG_HISILICON_ERRATUM_161010101 is not set
# CONFIG_ARM64_ERRATUM_858921 is not set
CONFIG_ROCKCHIP_IOMMU=y
CONFIG_PM_DEVFREQ=y
CONFIG_PWM=y
CONFIG_PWM_ROCKCHIP=y
CONFIG_PHY_ROCKCHIP_INNO_HDMI=y
CONFIG_PHY_ROCKCHIP_NANENG_COMBO_PHY=y
CONFIG_NVMEM=y
CONFIG_NVMEM_ROCKCHIP_OTP=y
CONFIG_EXT4_FS=y
CONFIG_EXT4_FS_POSIX_ACL=y
# CONFIG_DNOTIFY is not set
CONFIG_AUTOFS_FS=y
CONFIG_VFAT_FS=y
CONFIG_TMPFS=y
CONFIG_TMPFS_POSIX_ACL=y
# CONFIG_MISC_FILESYSTEMS is not set
CONFIG_NLS_CODEPAGE_437=y
CONFIG_NLS_ISO8859_1=y
CONFIG_CRYPTO=y
CONFIG_CRYPTO_GHASH_ARM64_CE=y
CONFIG_CRYPTO_AES_ARM64_CE_CCM=y
CONFIG_CRYPTO_DEV_ROCKCHIP=y
CONFIG_DMA_CMA=y
CONFIG_PRINTK_TIME=y
# CONFIG_SYMBOLIC_ERRNAME is not set
# CONFIG_SECTION_MISMATCH_WARN_ONLY is not set
# CONFIG_FTRACE is not set
# CONFIG_RUNTIME_TESTING_MENU is not set
```

## kas/meta-gadget/conf/distro/tezsign.conf
```bitbake
# conf/distro/tezsign.conf

# Inherit the absolute bare minimum metadata (compilers, basic bitbake rules)
require conf/distro/poky.conf

DISTRO = "tezsign"
DISTRO_NAME = "Tezsign"
DISTRO_VERSION = "1.0"

# ------------------------------------------------------------------
# THE OPT-IN APPROACH: OVERWRITE THE DEFAULTS COMPLETELY
# ------------------------------------------------------------------
# By using '=' instead of 'append', we wipe out Poky's massive list 
# and start from zero. We only add exactly what we need.

DISTRO_FEATURES = " \
    systemd \
    usrmerge \
    usbgadget \
"

MACHINE_ESSENTIAL_EXTRA_RDEPENDS = ""
MACHINE_EXTRA_RDEPENDS = ""

# Set systemd as the absolute default across the OS
INIT_MANAGER = "systemd"

# Disable Native Language Support globally
USE_NLS = "no"

# (Optional) Use a smaller C library if you want to get extreme, 
# though glibc is usually fine if you have 512MB RAM.
# TCLIBC = "musl"
```

## kas/meta-gadget/conf/layer.conf
```bitbake
BBPATH .= ":${LAYERDIR}"
BBFILES += "${LAYERDIR}/recipes-*/*/*.bb \
            ${LAYERDIR}/recipes-*/*/*.bbappend"

BBFILE_COLLECTIONS += "meta-gadget"
BBFILE_PATTERN_meta-gadget = "^${LAYERDIR}/"
BBFILE_PRIORITY_meta-gadget = "10"

# Change 'rpi' to 'raspberrypi'
LAYERDEPENDS_meta-gadget = "core raspberrypi"
LAYERSERIES_COMPAT_meta-gadget = "scarthgap"

PACKAGECONFIG:remove:pn-systemd = " \
    networkd resolved timesyncd nss-resolve \
    acl bluez dbus elfutils idn locale \
    manpages polkit seccomp xkbcommon \
"

IMAGE_LINGUAS = ""
FORCE_RO_REMOVE = "1"
NO_RECOMMENDATIONS = "1"
```

## kas/meta-gadget/conf/machine/raspberrypi0-2w-mainline.conf
```bitbake
include conf/machine/raspberrypi0-2w-64.conf

PREFERRED_PROVIDER_virtual/kernel = "linux-mainline"
PREFERRED_VERSION_linux-mainline ?= "6.18%"
RPI_KERNEL_DEVICETREE_OVERLAYS = ""
RPI_KERNEL_DEVICETREE = "broadcom/bcm2837-rpi-zero-2-w.dtb"
SERIAL_CONSOLES = "115200;ttyS1"
```

## kas/meta-gadget/wic/gadget copy.wks
```
# gadget.wks
# Partition 1: Boot (Contains firmware, kernel, and the cpio.gz RAM-disk)
part /boot --source bootimg-partition --fstype=vfat --label boot --active --align 4096 --fixed-size 128M

# Partition 2: App (Your 64MB request)
part /app --fstype=ext4 --label app --align 4096 --fixed-size 64M

# Partition 3: Data (Your 128MB request)
part /data --fstype=ext4 --label data --align 4096 --fixed-size 128M --mkfs-extraopts="-O has_journal"
```

## kas/meta-tezsign/conf/machine/raspberrypi0-2w-tezsign.conf
```bitbake
include conf/machine/raspberrypi0-2w-64.conf

PREFERRED_PROVIDER_virtual/kernel = "linux-mainline"
PREFERRED_VERSION_linux-mainline ?= "6.18+git"
RPI_KERNEL_DEVICETREE_OVERLAYS = ""
RPI_KERNEL_DEVICETREE = "broadcom/bcm2837-rpi-zero-2-w.dtb"
DISABLE_VC4GRAPHICS = "1"
SERIAL_CONSOLES = "115200;ttyS1"
RPI_EXTRA_IMAGE_BOOT_FILES = " \
    ${@bb.utils.contains('INITRAMFS_IMAGE_BUNDLE', '1', '${KERNEL_IMAGETYPE}-${INITRAMFS_LINK_NAME}.bin;${SDIMG_KERNELIMAGE}', '${KERNEL_IMAGETYPE};${SDIMG_KERNELIMAGE}', d)} \
"

IMAGE_BOOT_FILES:remove = "${BOOTFILES_DIR_NAME}/*"
IMAGE_BOOT_FILES:append = " \
    ${BOOTFILES_DIR_NAME}/bootcode.bin;bootcode.bin \
    ${BOOTFILES_DIR_NAME}/start.elf;start.elf \
    ${BOOTFILES_DIR_NAME}/fixup.dat;fixup.dat \
    ${BOOTFILES_DIR_NAME}/config.txt;config.txt \
    ${BOOTFILES_DIR_NAME}/cmdline.txt;cmdline.txt \
"
```

## kas/meta-tezsign/conf/machine/raspberrypi4-tezsign.conf
```bitbake
include conf/machine/raspberrypi4-64.conf

PREFERRED_PROVIDER_virtual/kernel = "linux-mainline"
PREFERRED_VERSION_linux-mainline ?= "6.18%"
RPI_KERNEL_DEVICETREE_OVERLAYS = ""
RPI_KERNEL_DEVICETREE = "broadcom/bcm2711-rpi-4-b.dtb"
DISABLE_VC4GRAPHICS = "1"
SERIAL_CONSOLES = "115200;ttyS1"
RPI_EXTRA_IMAGE_BOOT_FILES = " \
    ${@bb.utils.contains('INITRAMFS_IMAGE_BUNDLE', '1', '${KERNEL_IMAGETYPE}-${INITRAMFS_LINK_NAME}.bin;${SDIMG_KERNELIMAGE}', '${KERNEL_IMAGETYPE};${SDIMG_KERNELIMAGE}', d)} \
"

IMAGE_BOOT_FILES:remove = "${BOOTFILES_DIR_NAME}/*"
IMAGE_BOOT_FILES:append = " \
    ${BOOTFILES_DIR_NAME}/start4.elf;start4.elf \
    ${BOOTFILES_DIR_NAME}/fixup4.dat;fixup4.dat \
    ${BOOTFILES_DIR_NAME}/config.txt;config.txt \
    ${BOOTFILES_DIR_NAME}/cmdline.txt;cmdline.txt \
"
```
