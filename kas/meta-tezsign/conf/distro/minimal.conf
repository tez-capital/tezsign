## kas/meta-tezsign/conf/layer.conf
```bitbake
BBPATH .= ":${LAYERDIR}"
BBFILES += "${LAYERDIR}/recipes-*/*/*.bb \
            ${LAYERDIR}/recipes-*/*/*.bbappend"

BBFILE_COLLECTIONS += "meta-tezsign"
BBFILE_PATTERN_meta-tezsign = "^${LAYERDIR}/"
BBFILE_PRIORITY_meta-tezsign = "10"

LAYERDEPENDS_meta-tezsign = "core"
LAYERSERIES_COMPAT_meta-tezsign = "wrynose"

# IMAGE_LINGUAS = ""
# FORCE_RO_REMOVE = "1"

BBFILES_DYNAMIC += " \
    raspberrypi:${LAYERDIR}/dynamic-layers/raspberrypi/recipes-bsp/*/*.bbappend \
    rockchip:${LAYERDIR}/dynamic-layers/rockchip/recipes-bsp/*/*.bbappend \
"
```
